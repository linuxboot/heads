## config/coreboot-kano.config_defconfig
```kconfig
CONFIG_LOCALVERSION="MrChromebox-26.03"
CONFIG_BOOTSPLASH_IMAGE=y
CONFIG_BOOTSPLASH_FILE="@BRAND_DIR@/bootsplash.jpg"
CONFIG_VENDOR_GOOGLE=y
CONFIG_IFD_BIN_PATH="3rdparty/blobs/mainboard/google/brya/brya/kano/flashdescriptor.bin"
CONFIG_ME_BIN_PATH="3rdparty/blobs/mainboard/google/brya/brya/kano/me.bin"
CONFIG_BOARD_GOOGLE_KANO=y
CONFIG_HAVE_IFD_BIN=y
CONFIG_TPM_MEASURED_BOOT=y
CONFIG_POWER_STATE_OFF_AFTER_FAILURE=y
CONFIG_SOC_INTEL_COMMON_SPI_LOCKDOWN_SMM=y
# CONFIG_INTEL_CHIPSET_LOCKDOWN is not set
CONFIG_HAVE_ME_BIN=y
CONFIG_BOOTSPLASH=y
# CONFIG_RESOURCE_ALLOCATION_TOP_DOWN is not set
CONFIG_SMMSTORE=y
CONFIG_SMMSTORE_V2=y
CONFIG_SMMSTORE_SIZE=0x40000
CONFIG_TPM_PPI=y
CONFIG_BOOTMEDIA_LOCK_CONTROLLER=y
CONFIG_PAYLOAD_LINUX=y
CONFIG_PAYLOAD_FILE="@BOARD_BUILD_DIR@/bzImage"
CONFIG_LINUX_INITRD="@BOARD_BUILD_DIR@/initrd.cpio.xz"
```

## config/coreboot-kgpe-d16_workstation-tpm2.config_defconfig
```kconfig
CONFIG_LOCALVERSION="4.11_wip-tpm"
CONFIG_USE_OPTION_TABLE=y
CONFIG_VENDOR_ASUS=y
CONFIG_UART_FOR_CONSOLE=1
CONFIG_BOARD_ASUS_KGPE_D16=y
CONFIG_DRIVERS_PS2_KEYBOARD=y
CONFIG_PCIEXP_L1_SUB_STATE=y
CONFIG_LINUX_COMMAND_LINE="nohz=on console=tty0 earlyprintk=tty0 quiet loglevel=2"
CONFIG_COREBOOT_ROMSIZE_KB_16384=y
CONFIG_POWER_STATE_ON_AFTER_FAILURE=y
CONFIG_PCIEXP_ASPM=y
CONFIG_PCIEXP_COMMON_CLOCK=y
CONFIG_PCIEXP_CLK_PM=y
CONFIG_USER_TPM2=y
CONFIG_TPM_MEASURED_BOOT=y
CONFIG_PAYLOAD_LINUX=y
CONFIG_PAYLOAD_FILE="@BOARD_BUILD_DIR@/bzImage"
CONFIG_LINUX_INITRD="@BOARD_BUILD_DIR@/initrd.cpio.xz"
```

## config/coreboot-novacustom-v540tu.config_defconfig
```kconfig
CONFIG_LOCALVERSION="v1.0.1"
CONFIG_BOOTSPLASH_IMAGE=y
CONFIG_BOOTSPLASH_FILE="@BRAND_DIR@/bootsplash.jpg"
CONFIG_BOOTSPLASH_CONVERT=y
CONFIG_BOOTSPLASH_CONVERT_QUALITY=90
CONFIG_VENDOR_NOVACUSTOM=y
CONFIG_MAINBOARD_VENDOR="Clevo"
CONFIG_CBFS_SIZE=0x1000000
# CONFIG_CONSOLE_SERIAL is not set
# CONFIG_POST_IO is not set
# CONFIG_CONSOLE_POST is not set
CONFIG_FSP_FD_PATH="3rdparty/fsp/ArrowLakeFspBinPkg/IoT/ArrowLakeUH/Fsp.fd"
CONFIG_IFD_BIN_PATH="3rdparty/dasharo-blobs/novacustom/v5x0tu/descriptor.bin"
CONFIG_ME_BIN_PATH="3rdparty/dasharo-blobs/novacustom/v5x0tu/me.bin"
CONFIG_HAVE_IFD_BIN=y
CONFIG_BOARD_NOVACUSTOM_V540TU=y
CONFIG_TPM_MEASURED_BOOT=y
CONFIG_LINUX_COMMAND_LINE="quiet loglevel=2"
CONFIG_POWER_STATE_OFF_AFTER_FAILURE=y
CONFIG_FSP_HEADER_PATH="3rdparty/fsp/ArrowLakeFspBinPkg/IoT/ArrowLakeUH/Include"
CONFIG_SOFTWARE_CONNECTION_MANAGER=y
CONFIG_ENABLE_EARLY_DMA_PROTECTION=y
CONFIG_SOC_INTEL_COMMON_SPI_LOCKDOWN_SMM=y
CONFIG_VALIDATE_INTEL_DESCRIPTOR=y
# CONFIG_INTEL_CHIPSET_LOCKDOWN is not set
CONFIG_EC_DASHARO_EC_UPDATE=y
CONFIG_IFDTOOL_DISABLE_ME=y
CONFIG_HAVE_ME_BIN=y
CONFIG_INTEL_ME_DISABLED_HAP=y
CONFIG_BOOTSPLASH=y
# CONFIG_RESOURCE_ALLOCATION_TOP_DOWN is not set
CONFIG_ADD_FSP_BINARIES=y
CONFIG_FSP_FULL_FD=y
# CONFIG_USE_PC_CMOS_ALTCENTURY is not set
CONFIG_BOOTMEDIA_LOCK_CONTROLLER=y
CONFIG_PAYLOAD_LINUX=y
CONFIG_PAYLOAD_FILE="@BOARD_BUILD_DIR@/bzImage"
CONFIG_LINUX_INITRD="@BOARD_BUILD_DIR@/initrd.cpio.xz"
```
